/*
  Maker UNO Melody
  Generated by Portable MIDI to Arduino Converter
  Build by AgentHitmanFaris (NC-Engineering)
  Detected Info -> BPM: 188 | Time Sig: 3/4 | Key: Eb
  Song Name: Jodoh Lebaran
  Artist: Aisha Retno
*/

#include <avr/pgmspace.h>

#define BUZZER_PIN 8

const int melody[] PROGMEM = {
  -2,   0,   -2,   0,   -2,   0,   220,   -2,   220,   41, 
  -1,   220,   0,   -2,   246,   -2,   246,   0,   -2,   277, 
  -2,   277,   0,   -2,   41,   293,   146,   293,   146,   293, 
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  130,   261,   130,   261
};

const int noteDurations[] PROGMEM = {
  15,   144,   15,   145,   15,   64,   80,   15,   145,   15, 
  25,   249,   30,   15,   304,   15,   120,   25,   15,   304, 
  15,   120,   24,   15,   25,   60,   30,   30,   15,   60, 
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  15,   60,   30,   37
};


// --- TO ADJUST TEMPO: Increase for FASTER, decrease for SLOWER ---
float tempoMultiplier = 1.0;

const int noteCount = sizeof(melody) / sizeof(melody[0]);

void setup() {
  pinMode(BUZZER_PIN, OUTPUT);
}

void loop() {
  for (int i = 0; i < noteCount; i++) {
    int freq = pgm_read_word_near(melody + i);
    int duration = pgm_read_word_near(noteDurations + i);
    
    // Apply Tempo Multiplier
    int finalDuration = (int)(duration / tempoMultiplier);
    
    unsigned long noteStart = millis();
    if (freq > 0) {
      // Articulation: Play for 90% of duration, 10% silence
      tone(BUZZER_PIN, freq, finalDuration * 0.9);
    } else if (freq < 0) {
      // White Noise Drum Mode (-1 = Snare, -2 = HiHat)
      int maxDel = (freq == -1) ? 800 : 150;
      while (millis() - noteStart < finalDuration * 0.9) {
        digitalWrite(BUZZER_PIN, random(2));
        delayMicroseconds(random(50, maxDel));
      }
      digitalWrite(BUZZER_PIN, LOW);
    } else {
      noTone(BUZZER_PIN);
    }
    
    // Wait exactly the rest of the required duration length to maintain sync
    while (millis() - noteStart < finalDuration) {
      delay(1);
    }
    noTone(BUZZER_PIN);
  }
  delay(2000); // Wait 2 seconds before repeating
}
