/*
  Maker UNO Melody
  Generated by Portable MIDI to Arduino Converter
  Build by AgentHitmanFaris (NC-Engineering)
  Detected Info -> BPM: 140 | Time Sig: 4/4 | Key: C
  Song Name: Berakhir Di Aku
  Artist: Idgitaf
*/

#include <avr/pgmspace.h>

#define BUZZER_PIN 8

const int melody[] PROGMEM = {
  -2,   41,   587,   65,   587,   65,   -2,   65,   587,   65, 
  587,   65,   -2,   65,   587,   65,   587,   65,   -2,   65, 
  587,   65,   587,   0,   -2,   41,   659,   65,   659,   65, 
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  87,   -2,   87,   293,   87,   293,   87,   -2,   87,   293, 
  87
};

const int noteDurations[] PROGMEM = {
  15,   25,   60,   30,   60,   24,   15,   30,   60,   30, 
  60,   19,   15,   25,   60,   30,   60,   24,   15,   30, 
  60,   30,   36,   44,   15,   25,   60,   30,   60,   24, 
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  19,   15,   25,   60,   30,   60,   24,   15,   30,   60, 
  22
};


// --- TO ADJUST TEMPO: Increase for FASTER, decrease for SLOWER ---
float tempoMultiplier = 1.0;

const int noteCount = sizeof(melody) / sizeof(melody[0]);

void setup() {
  pinMode(BUZZER_PIN, OUTPUT);
}

void loop() {
  for (int i = 0; i < noteCount; i++) {
    int freq = pgm_read_word_near(melody + i);
    int duration = pgm_read_word_near(noteDurations + i);
    
    // Apply Tempo Multiplier
    int finalDuration = (int)(duration / tempoMultiplier);
    
    unsigned long noteStart = millis();
    if (freq > 0) {
      // Articulation: Play for 90% of duration, 10% silence
      tone(BUZZER_PIN, freq, finalDuration * 0.9);
    } else if (freq < 0) {
      // White Noise Drum Mode (-1 = Snare, -2 = HiHat)
      int maxDel = (freq == -1) ? 800 : 150;
      while (millis() - noteStart < finalDuration * 0.9) {
        digitalWrite(BUZZER_PIN, random(2));
        delayMicroseconds(random(50, maxDel));
      }
      digitalWrite(BUZZER_PIN, LOW);
    } else {
      noTone(BUZZER_PIN);
    }
    
    // Wait exactly the rest of the required duration length to maintain sync
    while (millis() - noteStart < finalDuration) {
      delay(1);
    }
    noTone(BUZZER_PIN);
  }
  delay(2000); // Wait 2 seconds before repeating
}
