/*
  Maker UNO Melody
  Generated by Portable MIDI to Arduino Converter
  Build by AgentHitmanFaris (NC-Engineering)
  Detected Info -> BPM: 120 | Time Sig: 4/4 | Key: C
  Song Name: The Dead Dance
  Artist: Lady Gaga
*/

#include <avr/pgmspace.h>

#define BUZZER_PIN 8

const int melody[] PROGMEM = {
  -2,   41,   523,   55,   523,   55,   523,   55,   523,   55, 
  523,   55,   523,   55,   -1,   55,   523,   55,   523,   55, 
  -2,   55,   523,   55,   523,   55,   523,   41,   523,   55, 
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  -1,   55,   880,   55,   880,   55,   -2,   55,   880,   55
};

const int noteDurations[] PROGMEM = {
  15,   25,   60,   30,   60,   30,   30,   15,   60,   30, 
  60,   30,   55,   15,   25,   30,   60,   30,   60,   30, 
  15,   30,   60,   30,   60,   30,   25,   15,   25,   30, 
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  25,   30,   60,   30,   60,   30,   15,   30,   60,   30
};


// --- TO ADJUST TEMPO: Increase for FASTER, decrease for SLOWER ---
float tempoMultiplier = 1.0;

const int noteCount = sizeof(melody) / sizeof(melody[0]);

void setup() {
  pinMode(BUZZER_PIN, OUTPUT);
}

void loop() {
  for (int i = 0; i < noteCount; i++) {
    int freq = pgm_read_word_near(melody + i);
    int duration = pgm_read_word_near(noteDurations + i);
    
    // Apply Tempo Multiplier
    int finalDuration = (int)(duration / tempoMultiplier);
    
    unsigned long noteStart = millis();
    if (freq > 0) {
      // Articulation: Play for 90% of duration, 10% silence
      tone(BUZZER_PIN, freq, finalDuration * 0.9);
    } else if (freq < 0) {
      // White Noise Drum Mode (-1 = Snare, -2 = HiHat)
      int maxDel = (freq == -1) ? 800 : 150;
      while (millis() - noteStart < finalDuration * 0.9) {
        digitalWrite(BUZZER_PIN, random(2));
        delayMicroseconds(random(50, maxDel));
      }
      digitalWrite(BUZZER_PIN, LOW);
    } else {
      noTone(BUZZER_PIN);
    }
    
    // Wait exactly the rest of the required duration length to maintain sync
    while (millis() - noteStart < finalDuration) {
      delay(1);
    }
    noTone(BUZZER_PIN);
  }
  delay(2000); // Wait 2 seconds before repeating
}
